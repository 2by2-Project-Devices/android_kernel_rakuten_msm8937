## techpack/tinno-c330ae/Kconfig
```kconfig
menu "Tinno C330AE project"
	depends on ARCH_SDM439

config MACH_TINNO_C330AE
	bool "Support for Tinno C330AE project"
	help
	  Say Y here to enable support for Tinno C330AE project.

if MACH_TINNO_C330AE
endif # MACH_TINNO_C330AE

endmenu
```

## techpack/tinno-c330ae/foursemi/Kconfig
```kconfig
config SND_SOC_FS16XX
	tristate "Foursemi FS16XX amplifier"
	depends on I2C
	help
	  Enables support for the Foursemi FS16XX smart amplifier.
```

## techpack/tinno-c330ae/ft8006p/Kconfig
```kconfig
#
# Focaltech Touchscreen driver configuration
#

config TOUCHSCREEN_FTS_FT8006P_C330AE
    bool "Focaltech Touchscreen"
    depends on I2C
    default n
    help
      Say Y here if you have Focaltech touch panel.
      If unsure, say N.
```

## techpack/tinno-c330ae/hall_sensor/Kconfig
```kconfig
config HALL_SENSOR
	tristate "Hall sensor support"
	depends on OF && INPUT
	help
	  Say Y here to enable the Hall sensor input driver used by
	  c330ae-class devices.
```
